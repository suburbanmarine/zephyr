## drivers/eeprom/Kconfig.rv3032
```kconfig
# Copyright (c) 2026 Schloss Automation LLC
# SPDX-License-Identifier: Apache-2.0

config EEPROM_RV3032
	bool "RV3032 User EEPROM driver"
	default y
	depends on DT_HAS_MICROCRYSTAL_RV3032_EEPROM_ENABLED
	select MFD_RV3032
	help
		Enable RV3032 32 byte user EEPROM area 
```
